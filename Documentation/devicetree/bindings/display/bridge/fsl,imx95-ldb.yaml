## Documentation/devicetree/bindings/display/bridge/fsl,imx95-ldb.yaml
```yaml
# SPDX-License-Identifier: (GPL-2.0-only OR BSD-2-Clause)
%YAML 1.2
---
$id: http://devicetree.org/schemas/display/bridge/fsl,imx95-ldb.yaml#
$schema: http://devicetree.org/meta-schemas/core.yaml#

title: Freescale i.MX95 LVDS Display Bridge

maintainers:
  - NXP Semiconductor <imx@lists.linux.dev>

description: |
  The Freescale i.MX95 LVDS Display Bridge (LDB) serializes parallel RGB
  data from the display pipeline into LVDS output. It has two channels,
  each with an LVDS PHY. Each channel can be used independently for a
  single-link LVDS display, or both channels can be used together in
  split mode for a dual-link LVDS display.

  The i.MX95 LDB is controlled by Control and Status Registers (CSR)
  within the LVDS CSR syscon. The LDB node is a child of the syscon.

properties:
  compatible:
    const: fsl,imx95-ldb

  reg:
    maxItems: 1
    description:
      Offset of the LDB control register within the parent LVDS CSR syscon.

  clocks:
    minItems: 4
    maxItems: 4

  clock-names:
    items:
      - const: ldb_ch0
      - const: ldb_di0
      - const: ldb_ch1
      - const: ldb_di1

  "#address-cells":
    const: 1

  "#size-cells":
    const: 0

patternProperties:
  "^channel@[0-1]$":
    type: object
    description: Represents a channel of LDB.

    properties:
      "#address-cells":
        const: 1

      "#size-cells":
        const: 0

      reg:
        description: The channel index.
        enum: [0, 1]

      phys:
        description: A phandle to the LVDS PHY for this channel.
        maxItems: 1

      phy-names:
        const: lvds_phy

      port@0:
        $ref: /schemas/graph.yaml#/properties/port
        description:
          Input port of the channel, connected to a pixel link
          output port.

      port@1:
        $ref: /schemas/graph.yaml#/properties/port
        description:
          Output port of the channel, connected to an LVDS display
          or LVDS-to-HDMI bridge (e.g. IT6263).

    required:
      - "#address-cells"
      - "#size-cells"
      - reg
      - phys
      - phy-names
      - port@1

    additionalProperties: false

required:
  - compatible
  - reg
  - clocks
  - clock-names
  - "#address-cells"
  - "#size-cells"

allOf:
  - if:
      properties:
        compatible:
          contains:
            const: fsl,imx95-ldb
    then:
      properties:
        channel@0: false

additionalProperties: false

examples:
  - |
    #include <dt-bindings/clock/nxp,imx95-clock.h>

    lvds_csr: syscon@4b0c0000 {
        compatible = "nxp,imx95-lvds-csr", "syscon", "simple-mfd";
        reg = <0x4b0c0000 0x10000>;

        ldb@4 {
            compatible = "fsl,imx95-ldb";
            reg = <0x4>;
            clocks = <&lvds_csr 1>,
                     <&lvds_csr 3>,
                     <&lvds_csr 2>,
                     <&lvds_csr 4>;
            clock-names = "ldb_ch0", "ldb_di0",
                          "ldb_ch1", "ldb_di1";
            #address-cells = <1>;
            #size-cells = <0>;

            channel@0 {
                #address-cells = <1>;
                #size-cells = <0>;
                reg = <0>;
                phys = <&ldb0_phy>;
                phy-names = "lvds_phy";

                port@1 {
                    reg = <1>;

                    endpoint {
                        remote-endpoint = <&lvds_panel>;
                    };
                };
            };

            channel@1 {
                #address-cells = <1>;
                #size-cells = <0>;
                reg = <1>;
                phys = <&ldb1_phy>;
                phy-names = "lvds_phy";

                port@1 {
                    reg = <1>;

                    endpoint {
                        remote-endpoint = <&it6263_in>;
                    };
                };
            };
        };

        ldb0_phy: phy@8 {
            compatible = "fsl,imx95-lvds0-phy";
            reg = <0x8>;
            #phy-cells = <0>;
        };

        ldb1_phy: phy@c {
            compatible = "fsl,imx95-lvds1-phy";
            reg = <0xc>;
            #phy-cells = <0>;
        };
    };
```

## Documentation/devicetree/bindings/display/bridge/nxp,imx95-dc-pixel-link.yaml
```yaml
# SPDX-License-Identifier: (GPL-2.0-only OR BSD-2-Clause)
%YAML 1.2
---
$id: http://devicetree.org/schemas/display/bridge/nxp,imx95-dc-pixel-link.yaml#
$schema: http://devicetree.org/meta-schemas/core.yaml#

title: NXP i.MX95 Display Pixel Link

maintainers:
  - NXP Semiconductor <imx@lists.linux.dev>

description: |
  The i.MX95 Display Pixel Link forms an asynchronous crossbar linkage
  between pixel sources (pixel interleaver output channels) and pixel
  consumers (LVDS Display Bridge, MIPI DSI, etc.). It is implemented
  as a set of registers within the Display Master CSR syscon.

  Each of the two pixel streams has one input port and one output port.
  Output ports may have multiple endpoints to support routing the same
  stream to different downstream bridges.

properties:
  compatible:
    const: nxp,imx95-dc-pixel-link

  reg:
    maxItems: 1
    description:
      Offset of the pixel link control register within the parent
      Display Master CSR syscon.

  ports:
    $ref: /schemas/graph.yaml#/properties/ports

    properties:
      port@0:
        $ref: /schemas/graph.yaml#/properties/port
        description: Input port for stream 0 from pixel interleaver channel 0.

      port@1:
        $ref: /schemas/graph.yaml#/properties/port
        description: Input port for stream 1 from pixel interleaver channel 1.

      port@2:
        $ref: /schemas/graph.yaml#/properties/port
        description: Output port for stream 0 to downstream bridge(s).

      port@3:
        $ref: /schemas/graph.yaml#/properties/port
        description: Output port for stream 1 to downstream bridge(s).

    required:
      - port@0
      - port@1
      - port@2
      - port@3

required:
  - compatible
  - reg
  - ports

additionalProperties: false

examples:
  - |
    dispmix_csr: syscon@4b010000 {
        compatible = "nxp,imx95-display-csr", "syscon", "simple-mfd";
        reg = <0x4b010000 0x10000>;

        display-pixel-link@8 {
            compatible = "nxp,imx95-dc-pixel-link";
            reg = <0x8>;

            ports {
                #address-cells = <1>;
                #size-cells = <0>;

                port@0 {
                    reg = <0>;

                    endpoint {
                        remote-endpoint = <&pixel_interleaver_ch0_out>;
                    };
                };

                port@1 {
                    reg = <1>;

                    endpoint {
                        remote-endpoint = <&pixel_interleaver_ch1_out>;
                    };
                };

                port@2 {
                    reg = <2>;

                    endpoint {
                        remote-endpoint = <&ldb_ch0_in>;
                    };
                };

                port@3 {
                    reg = <3>;

                    endpoint {
                        remote-endpoint = <&ldb_ch1_in>;
                    };
                };
            };
        };
    };
```

## Documentation/devicetree/bindings/display/bridge/nxp,imx95-pixel-interleaver.yaml
```yaml
# SPDX-License-Identifier: (GPL-2.0-only OR BSD-2-Clause)
%YAML 1.2
---
$id: http://devicetree.org/schemas/display/bridge/nxp,imx95-pixel-interleaver.yaml#
$schema: http://devicetree.org/meta-schemas/core.yaml#

title: NXP i.MX95 Pixel Interleaver

maintainers:
  - NXP Semiconductor <imx@lists.linux.dev>

description: |
  The i.MX95 Pixel Interleaver takes up to two output streams from the
  Display Controller and interleaves them (split mode) or passes them
  through (bypass mode) to the Pixel Link crossbar in the Display Master
  CSR. It is used to support dual-display and high-resolution configurations.

properties:
  compatible:
    const: nxp,imx95-pixel-interleaver

  reg:
    maxItems: 1

  interrupts:
    maxItems: 1
    description: overflow/error interrupt for all streams

  clocks:
    maxItems: 1
    description: bus interface clock

  nxp,blk-ctrl:
    $ref: /schemas/types.yaml#/definitions/phandle
    description:
      A phandle to the block control syscon (dispmix_csr) which contains
      the pixel interleaver control register.

  nxp,pixel-interleaving-stream-id:
    $ref: /schemas/types.yaml#/definitions/uint8
    enum: [0, 1]
    description:
      The display stream index used in pixel interleaving mode. If present,
      the pixel interleaver operates in STREAMx_SPLIT2 mode instead of bypass.
      The selected stream is split across both channels.

  "#address-cells":
    const: 1

  "#size-cells":
    const: 0

patternProperties:
  "^channel@[0-1]$":
    type: object
    description: Represents a display stream channel.

    properties:
      "#address-cells":
        const: 1

      "#size-cells":
        const: 0

      reg:
        description: The channel index.
        enum: [0, 1]

      port@0:
        $ref: /schemas/graph.yaml#/properties/port
        description:
          Input port of the channel, connected to a Display Controller
          output port (DC port@N).

      port@1:
        $ref: /schemas/graph.yaml#/properties/port
        description:
          Output port of the channel, connected to the pixel link input port.

    required:
      - "#address-cells"
      - "#size-cells"
      - reg
      - port@0
      - port@1

    additionalProperties: false

required:
  - compatible
  - reg
  - interrupts
  - clocks
  - nxp,blk-ctrl
  - "#address-cells"
  - "#size-cells"

additionalProperties: false

examples:
  - |
    #include <dt-bindings/interrupt-controller/arm-gic.h>
    #include <dt-bindings/clock/nxp,imx95-clock.h>

    pixel-interleaver@4b0d0000 {
        compatible = "nxp,imx95-pixel-interleaver";
        reg = <0x4b0d0000 0x10000>;
        interrupts = <GIC_SPI 63 IRQ_TYPE_LEVEL_HIGH>;
        clocks = <&scmi_clk IMX95_CLK_BUSWAKEUP>;
        nxp,blk-ctrl = <&dispmix_csr>;
        #address-cells = <1>;
        #size-cells = <0>;

        channel@0 {
            #address-cells = <1>;
            #size-cells = <0>;
            reg = <0>;

            port@0 {
                reg = <0>;

                endpoint {
                    remote-endpoint = <&dc_port0>;
                };
            };

            port@1 {
                reg = <1>;

                endpoint {
                    remote-endpoint = <&pixel_link_in0>;
                };
            };
        };

        channel@1 {
            #address-cells = <1>;
            #size-cells = <0>;
            reg = <1>;

            port@0 {
                reg = <0>;

                endpoint {
                    remote-endpoint = <&dc_port1>;
                };
            };

            port@1 {
                reg = <1>;

                endpoint {
                    remote-endpoint = <&pixel_link_in1>;
                };
            };
        };
    };
```

## Documentation/devicetree/bindings/media/nxp,imx95-neoisp.yaml
```yaml
# SPDX-License-Identifier: (GPL-2.0-only OR BSD-2-Clause)
%YAML 1.2
---
$id: http://devicetree.org/schemas/media/nxp,imx95-neoisp.yaml#
$schema: http://devicetree.org/meta-schemas/core.yaml#

title: NXP NEOISP Image Signal Processing Pipeline

maintainers:
  - Antoine Bouyer <antoine.bouyer@nxp.com>

description:
  The NXP NEOISP performs a set of image processing tasks on the RAW camera
  stream and provides RGB or YUV enhanced image.

properties:
  compatible:
    enum:
      - nxp,imx95-neoisp

  reg:
    items:
      - description: The configuration registers
      - description: ISP local memories

  interrupts:
    maxItems: 1

  clocks:
    items:
      - description: AXI bus clock
      - description: pixel clock
      - description: ISP core clock

  clock-names:
    items:
      - const: camblk_isp_axi
      - const: camblk_isp_pixel
      - const: camblk_isp

  power-domains:
    maxItems: 1

required:
  - compatible
  - reg
  - interrupts
  - clocks
  - clock-names
  - power-domains

additionalProperties: false

examples:
  - |
    #include <dt-bindings/interrupt-controller/arm-gic.h>

    isp@4ae00000 {
        compatible = "nxp,imx95-neoisp";
        reg = <0x4ae00000 0x8000>,
              <0x4afe0000 0x10000>;
        interrupts = <GIC_SPI 222 IRQ_TYPE_LEVEL_HIGH>;
        interrupt-parent = <&gic>;
        clocks = <&cameramix_csr 0>, <&cameramix_csr 1>, <&cameramix_csr 2>;
        clock-names = "camblk_isp_axi", "camblk_isp_pixel", "camblk_isp";
        power-domains = <&scmi_devpd 3>; /* IMX95_PD_CAMERA */
    };
```

## Documentation/devicetree/bindings/phy/fsl,imx8mp-lvds-phy.yaml
```yaml
# SPDX-License-Identifier: (GPL-2.0-only OR BSD-2-Clause)
%YAML 1.2
---
$id: http://devicetree.org/schemas/phy/fsl,imx8mp-lvds-phy.yaml#
$schema: http://devicetree.org/meta-schemas/core.yaml#

title: Freescale i.MX8MP/i.MX93/i.MX95 LVDS PHY

maintainers:
  - NXP Semiconductor <imx@lists.linux.dev>

description: |
  The LVDS PHY converts parallel CMOS data into LVDS data streams.
  On i.MX8MP and i.MX93, a single controller manages two PHY channels.
  On i.MX95, each PHY channel is a separate controller instance.

  The PHY registers are accessed via a syscon phandle.

properties:
  compatible:
    enum:
      - fsl,imx8mp-lvds-phy
      - fsl,imx93-lvds-phy
      - fsl,imx95-lvds0-phy
      - fsl,imx95-lvds1-phy

  reg:
    maxItems: 1
    description:
      Offset of the PHY control register within the parent syscon.

  gpr:
    $ref: /schemas/types.yaml#/definitions/phandle
    description:
      Phandle to the syscon (LVDS CSR) containing the PHY registers.

  "#phy-cells":
    const: 0

  clocks:
    maxItems: 1

  clock-names:
    const: apb

required:
  - compatible
  - reg
  - gpr
  - "#phy-cells"
  - clocks
  - clock-names

additionalProperties: false

examples:
  - |
    #include <dt-bindings/clock/nxp,imx95-clock.h>

    lvds_csr: syscon@4b0c0000 {
        compatible = "nxp,imx95-lvds-csr", "syscon", "simple-mfd";
        reg = <0x4b0c0000 0x10000>;

        lvds0-phy@8 {
            compatible = "fsl,imx95-lvds0-phy";
            reg = <0x8>;
            gpr = <&lvds_csr>;
            #phy-cells = <0>;
            clocks = <&scmi_clk IMX95_CLK_BUSWAKEUP>;
            clock-names = "apb";
        };

        lvds1-phy@c {
            compatible = "fsl,imx95-lvds1-phy";
            reg = <0xc>;
            gpr = <&lvds_csr>;
            #phy-cells = <0>;
            clocks = <&scmi_clk IMX95_CLK_BUSWAKEUP>;
            clock-names = "apb";
        };
    };
```

## drivers/gpu/drm/imx/dc/Kconfig
```kconfig
config DRM_IMX_DC_LIB
	tristate
	select DRM_CLIENT_SELECTION
	select DRM_GEM_DMA_HELPER
	select DRM_KMS_HELPER
	select DRM_DISPLAY_HELPER
	select DRM_BRIDGE_CONNECTOR
	select GENERIC_IRQ_CHIP
	select REGMAP
	select REGMAP_MMIO

config DRM_IMX8QXP_DC
	tristate "NXP i.MX8QXP DC8000 Display Controller"
	depends on DRM && COMMON_CLK && OF && (ARCH_MXC || COMPILE_TEST)
	depends on IMX_SCU
	select DRM_IMX_DC_LIB
	help
	  DRM driver for the DC8000 display controller found in NXP i.MX8QXP.
	  Enables LVDS and DisplayPort output via the DC component framework.

config DRM_IMX95_DC
	tristate "NXP i.MX95 DC8000 Display Controller"
	depends on DRM && COMMON_CLK && OF && (ARCH_MXC || COMPILE_TEST)
	select DRM_IMX_DC_LIB
	help
	  DRM driver for the DC8000 display controller found in NXP i.MX95.
	  Enables LVDS output via pixel-interleaver -> LDB -> LVDS PHY -> IT6263 HDMI.
```
